# file: RFID_DOOR_TB.ioc
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Mcu.Family=STM32F1
Mcu.Name=STM32F103C(8-B)Tx
Mcu.Package=LQFP48
NVIC.PriorityGroup=NVIC_PRIORITYGROUP_4
PA13.Mode=Serial_Wire
PA13.Signal=SYS_JTMS-SWDIO
PA14.Mode=Serial_Wire
PA14.Signal=SYS_JTCK-SWCLK
PD0-OSC_IN.Mode=HSE-External-Oscillator
PD0-OSC_IN.Signal=RCC_OSC_IN
PD1-OSC_OUT.Mode=HSE-External-Oscillator
PD1-OSC_OUT.Signal=RCC_OSC_OUT
ProjectManager.HeapSize=0x200
ProjectManager.StackSize=0x400
ProjectManager.TargetToolchain=STM32CubeIDE
RCC.APB1Freq_Value=8000000
RCC.APB2Freq_Value=8000000
board=custom

// file: Core/Src/main.c
/* USER CODE BEGIN Header */
/**
  ******************************************************************************
  * @file           : main.c
  * @brief          : Main program body
  ******************************************************************************
  * @attention
  *
  * Copyright (c) 2023 STMicroelectronics.
  * All rights reserved.
  *
  * This software is licensed under terms that can be found in the LICENSE file
  * in the root directory of this software component.
  * If no LICENSE file comes with this software, it is provided AS-IS.
  *
  ******************************************************************************
  */
/* USER CODE END Header */
#include "main.h"

/* USER CODE BEGIN Includes */
#include "key_pad_basic.h"
/* USER CODE END Includes */

/* USER CODE BEGIN PTD */
typedef enum
{
  INIT_STATE = 0,
  OPEN_DOOR_STATE,
  PASSWORD_IDENTIFICATION,
  USER_MODE_KEYPAD,
  USER_MODE_CARD,
  ADMIN_MODE,
  ADMINISTRATOR,
  CHANGE_PASSWORD_ADMIN,
  UNBLOCK_USER,
  CHANGE_PASSWORD_USER,
  ADD_NEW_CARD,
  BLOCK_USER_STATE,
  BLOCK_ADMIN_STATE
} state_handle_t;
/* USER CODE END PTD */

/* USER CODE BEGIN PV */
state_handle_t state_task = INIT_STATE;
state_door_t state_door;
uint8_t data_keypad[15];
uint8_t data_temp;
uint8_t data = 13;
static uint8_t state_no_null;
static uint8_t change_state_null = 1;
/* USER CODE END PV */

void SystemClock_Config(void);
static void MX_GPIO_Init(void);

/* USER CODE BEGIN 0 */
void STATE_BUTTON_Handle(void)
{
  if (data == 13)
  {
    if (state_no_null == 1)
    {
      change_state_null = 1;
      state_no_null = 0;
    }
  }
  else
  {
    state_no_null = 1;
  }
}

uint8_t ENTER_Password(uint8_t *data_keypad)
{
  static uint8_t dest = 0;

  data = (uint8_t)keypad_handle();
  if ((data != 13) &&  (change_state_null == 1))
  {
    if ((data == '#') || (data == '*'))
    {
      dest = 0;
      return data;
    }
    *(data_keypad + dest) = data;
    dest = dest + 1;
    change_state_null = 0;
  }
  return 0;
}

void task_handle(void)
{
  switch (state_task)
  {
  case INIT_STATE:
    state_door = Init_Door();
    if (state_door == BLOCK_USER)
    {
      state_task = BLOCK_USER_STATE;
    }
    else
    {
      state_task = PASSWORD_IDENTIFICATION;
    }

    break;

  case OPEN_DOOR_STATE:
    OPEN_DOOR();
    // turn off backlight
    state_task = PASSWORD_IDENTIFICATION;
    break;

  case PASSWORD_IDENTIFICATION:
    data_temp = ENTER_Password(data_keypad);
    if (data_temp != 0)
    {
      if (data_temp == '#')
      {
        state_door = Password_identification(data_keypad);
        if (state_door == USER_ACCESS)
        {
          state_task = USER_MODE_KEYPAD;
        }
        else
        {
          state_task = ADMIN_MODE;
        }
      }
      else if (data_temp == '*')
      {
        state_task = INIT_STATE;
      }
    }

  case USER_MODE_CARD:
    // check uid card
    break;

  case USER_MODE_KEYPAD:
    state_door = USER_Mode_Keypad(data_keypad);
    memset(data_keypad, 0, sizeof(data_keypad));
    if (state_door == OPEN_DOOR)
    {
      state_task = OPEN_DOOR_STATE;
    }
    else if (state_door == CLOSE_DOOR)
    {
      state_task = PASSWORD_IDENTIFICATION;
    }
    else
    {
      state_task = BLOCK_USER_STATE;
    }
    break;

  case ADMIN_MODE:
    state_door = ADMIN_Mode(data_keypad);
    memset(data_keypad, 0, sizeof(data_keypad));
    if (state_door == ADMIN_ACCESS_SUCCESSFULLY)
    {
      data_temp = ENTER_Password(data_keypad);
      if (data_temp == '#')
      {
        if (*data_keypad == '1')
        {
          state_task = ADMINISTRATOR;
        }
        else if (*data_keypad == '2')
        {
          state_task = CHANGE_PASSWORD_USER;
        }
        else
        {
          state_task = ADD_NEW_CARD;
        }
      }
      else if (data_temp == '*')
      {
        state_task = PASSWORD_IDENTIFICATION;
      }
    }
    else if (state_door == ADMIN_ACCESS_FAILED)
    {
      state_task = PASSWORD_IDENTIFICATION;
    }
    else
    {
      state_task = BLOCK_ADMIN_STATE;
    }
    break;

  case ADMINISTRATOR:
    uint8_t data = 0;
    data = _Administrator();
    if(data == 1) state_task = CHANGE_PASSWORD_ADMIN;
    if(data == 1) state_task = UNBLOCK_USER;
    break;

  case CHANGE_PASSWORD_ADMIN:
    data_temp = ENTER_Password(data_keypad);
    if (data_temp != 0)
    {
      state_door = __Change_password_admin(data_keypad, data_temp);
      if (state_door == STATE_END)
      {
        HAL_Delay(500);
        state_task = ADMIN_MODE;
      }
      else if (state_door == STATE_FORWARD)
      {
        state_task = ADMINISTRATOR;
      }
    }
    break;

  case UNBLOCK_USER:
    state_door = __Unblock_User();
    if (state_door == STATE_END)
    {
      HAL_Delay(500);
      state_task = ADMIN_MODE;
    }
    else if (state_door == STATE_FORWARD)
    {
      state_task = ADMINISTRATOR;
    }
    break;

  case CHANGE_PASSWORD_USER:
    data_temp = ENTER_Password(data_keypad);
    if (data_temp != 0)
    {
      state_door = _Change_password_user(data_keypad, data_temp);
      if (state_door == STATE_END)
      {
        HAL_Delay(500);
        state_task = ADMIN_MODE;
      }
    }
    break;

  case ADD_NEW_CARD:

    break;

  case BLOCK_USER_STATE:
    DISPLAY_Block_User(&lcd_0);
    HAL_Delay(500);
    state_task = PASSWORD_IDENTIFICATION;
    break;

  case BLOCK_ADMIN_STATE:
    DISPLAY_Block_Admin(&lcd_0);
    break;
  default:
    break;
  }
}
/* USER CODE END 0 */

int main(void)
{

  /* MCU Configuration--------------------------------------------------------*/

  /* Reset of all peripherals, Initializes the Flash interface and the Systick. */
  HAL_Init();

  /* Configure the system clock */
  SystemClock_Config();

  /* Initialize all configured peripherals */
  MX_GPIO_Init();

  /* Infinite loop */
  while (1)
  {

  }
}

void SystemClock_Config(void)
{
  RCC_OscInitTypeDef RCC_OscInitStruct = {0};
  RCC_ClkInitTypeDef RCC_ClkInitStruct = {0};

  /** Initializes the RCC Oscillators according to the specified parameters
  * in the RCC_OscInitTypeDef structure.
  */
  RCC_OscInitStruct.OscillatorType = RCC_OSCILLATORTYPE_HSI;
  RCC_OscInitStruct.HSIState = RCC_HSI_ON;
  RCC_OscInitStruct.HSICalibrationValue = RCC_HSICALIBRATION_DEFAULT;
  RCC_OscInitStruct.PLL.PLLState = RCC_PLL_NONE;
  if (HAL_RCC_OscConfig(&RCC_OscInitStruct) != HAL_OK)
  {
    Error_Handler();
  }

  /** Initializes the CPU, AHB and APB buses clocks
  */
  RCC_ClkInitStruct.ClockType = RCC_CLOCKTYPE_HCLK|RCC_CLOCKTYPE_SYSCLK
                              |RCC_CLOCKTYPE_PCLK1|RCC_CLOCKTYPE_PCLK2;
  RCC_ClkInitStruct.SYSCLKSource = RCC_SYSCLKSOURCE_HSI;
  RCC_ClkInitStruct.AHBCLKDivider = RCC_SYSCLK_DIV1;
  RCC_ClkInitStruct.APB1CLKDivider = RCC_HCLK_DIV1;
  RCC_ClkInitStruct.APB2CLKDivider = RCC_HCLK_DIV1;

  if (HAL_RCC_ClockConfig(&RCC_ClkInitStruct, FLASH_LATENCY_0) != HAL_OK)
  {
    Error_Handler();
  }
}

static void MX_GPIO_Init(void)
{

  /* GPIO Ports Clock Enable */
  __HAL_RCC_GPIOD_CLK_ENABLE();
  __HAL_RCC_GPIOA_CLK_ENABLE();

}

void Error_Handler(void)
{
  __disable_irq();
  while (1)
  {
  }
}
